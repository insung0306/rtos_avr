unsigned long pre_micros;
unsigned long pre_millis;

int count=0;
int num=0;
int j=0;

char a[10][8] = {
  {0x00,0x38,0x44,0x4c,0x54,0x64,0x44,0x38},
  {0x00,0x10,0x30,0x50,0x10,0x10,0x10,0x7c},
  {0x00,0x38,0x44,0x04,0x08,0x10,0x20,0x7c},
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  {0x00,0x38,0x44,0x44,0x3c,0x04,0x44,0x38}
                };
char b[10][8] = {
  {0x00,0x38,0x44,0x4c,0x54,0x64,0x44,0x38},
  {0x00,0x10,0x30,0x50,0x10,0x10,0x10,0x7c},
  {0x00,0x38,0x44,0x04,0x08,0x10,0x20,0x7c},
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  {0x00,0x38,0x44,0x44,0x3c,0x04,0x44,0x38}
                };                

//{0x00,0x10,0x30,0x50,0x10,0x10,0x10,0x7c};
//{0x00,0x38,0x44,0x04,0x08,0x10,0x20,0x7c};

void setup() {
  //--------dot-matrix-ROW---------------
  pinMode(2,OUTPUT);
  pinMode(3,OUTPUT);
  pinMode(4,OUTPUT);
  pinMode(5,OUTPUT);
  pinMode(6,OUTPUT);
  pinMode(7,OUTPUT);
  pinMode(8,OUTPUT);
  pinMode(9,OUTPUT);

  //-------dot-matrix-COL-----------------
  pinMode(10,OUTPUT);
  pinMode(11,OUTPUT);
  pinMode(12,OUTPUT);
  pinMode(13,OUTPUT);
  pinMode(14,OUTPUT);
  pinMode(15,OUTPUT);
  pinMode(16,OUTPUT);
  pinMode(17,OUTPUT);

}


void loop() {
  unsigned long cur_micros = micros();
  unsigned long cur_millis = millis();

  if(cur_millis - pre_millis >= 100){
    pre_millis = cur_millis;

    for(int i=0; i<8; i++){
      a[num][i] = a[num][i] >> 1;
    }
    count++;
    if(count >= 8){
      for(int i=0; i<8; i++){
        a[num][i] = b[num][i];
      }
      num++;
      if(num >= 10){
        num=0;
      }
      count = 0;
    }
  }

  if(cur_micros - pre_micros >= 2500){
    pre_micros = cur_micros;

    for(int i=0; i<8; i++){
      digitalWrite(i+2,LOW);
    }
    
    
    for(int i=0; i<8; i++){
      if(a[num][j] & (0x80 >> i))
        digitalWrite(i+10,LOW);
      else
        digitalWrite(i+10,HIGH);
    }
    
    digitalWrite(j+2,HIGH);
   
    j++;
    if(j>=8){
      j=0;
    }
  }
  
}
